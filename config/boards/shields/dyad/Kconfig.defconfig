## config/boards/shields/dyad/Kconfig.defconfig
```kconfig
# Copyright (c) 2022 The ZMK Contributors
# SPDX-License-Identifier: MIT

if SHIELD_DYAD_CENTRAL_LEFT

config ZMK_KEYBOARD_NAME
    default "DYAD"
    
config ZMK_SPLIT_ROLE_CENTRAL
    default y

endif

if  SHIELD_DYAD_CENTRAL_LEFT || SHIELD_DYAD_PERIPHERAL_RIGHT

config ZMK_SPLIT
    default y

endif
```

## config/boards/shields/dyad/Kconfig.shield
```kconfig
# Copyright (c) 2020 The ZMK Contributors
# SPDX-License-Identifier: MIT

config SHIELD_DYAD_CENTRAL_LEFT
    def_bool $(shields_list_contains,dyad_central_left)

config SHIELD_DYAD_PERIPHERAL_RIGHT
    def_bool $(shields_list_contains,dyad_peripheral_right)
```
